## Keypad Drivers/custom_board_sx1508/build/Kconfig/Kconfig.shield
```kconfig
osource "c:/projects/smart_ble_remote/boards/shields/*/Kconfig.shield"
osource "c:/projects/boards/shields/*/Kconfig.shield"
osource "c:/projects/kscan_sx1508/boards/shields/*/Kconfig.shield"
osource "C:/ncs/v2.5.0/nrf/boards/shields/*/Kconfig.shield"
```

## Smart_Ble_Remote/custom_board_app/build/Kconfig/Kconfig.shield.defconfig
```kconfig
osource "c:/projects/smart_ble_remote/boards/shields/*/Kconfig.defconfig"
osource "c:/projects/boards/shields/*/Kconfig.defconfig"
osource "c:/projects/kscan_sx1508/boards/shields/*/Kconfig.defconfig"
osource "c:/projects/kscan_sx1508_1/boards/shields/*/Kconfig.defconfig"
osource "C:/ncs/v2.5.0/nrf/boards/shields/*/Kconfig.defconfig"
```

## Smart_Ble_Remote/fxls8974cf_drivers/dts/bindings/sensor/nxp,fxls8974cf.yaml
```yaml
# Copyright (c) 2019 Nordic Semiconductor ASA
# SPDX-License-Identifier: Apache-2.0

description: NXP Microelectronics fxls8974cf 3-axis accelerometer

compatible: "nxp,fxls8974cf"

include: "i2c-device.yaml"
```

## Smart_Ble_Remote/sx1508_drivers/drivers/kscan/Kconfig.sx1508
```kconfig
# Copyright (c) 2019 - 2021 Henrik Brix Andersen <henrik@brixandersen.dk>
# SPDX-License-Identifier: Apache-2.0

config KSCAN_SX1508
	bool "sx1508 keyscan driver"
	default n
	help
	  Enable keyscan driver for SX1508.

	  The SX1508 is a memory mapping, multifunction BUTTON
	  controller driver. The controller supports matrix key scan
	  circuit of up to 4x4 keys.
```

## Zephyr drivers/zephry_driver/sx1508_kscan/Kconfig
```kconfig
# Keyboard scan configuration options

# Copyright (c) 2019 Intel Corporation
# SPDX-License-Identifier: Apache-2.0

menuconfig KSCAN_SX1508
	bool "Keyboard scan drivers"
	help
	  Include Keyboard scan drivers in system config.

if KSCAN_SX1508

source "drivers/sx1508_kscan/Kconfig.g
source "drivers/sx1508_kscan/Kconfig.sx1508"

module = KSCAN_SX1508
module-str = sx1508_kscan
source "subsys/logging/Kconfig.template.log_config"

config KSCAN_INIT_PRIORITY
	int "Keyboard scan driver init priority"
	default 30
	help
	  Keyboard scan device driver initialization priority.

endif # KSCAN_SX1508
```

## customboard_kscan_sx1508/boards/arm/neevee_remote_52840/Kconfig.board
```kconfig
# Copyright (c) 2024 Nordic Semiconductor ASA
# SPDX-License-Identifier: Apache-2.0

config BOARD_NEEVEE_REMOTE_52840
	bool "neevee_remote_52840"
	depends on SOC_NRF52840_QIAA
```

## customboard_kscan_sx1508/boards/arm/neevee_remote_52840/Kconfig.defconfig
```kconfig
# Copyright (c) 2024 Nordic Semiconductor ASA
# SPDX-License-Identifier: Apache-2.0

if BOARD_NEEVEE_REMOTE_52840

config BOARD
	default "neevee_remote_52840"

config BT_CTLR
   default BT


endif
```

## drivers/kscan/Kconfig
```kconfig
# Keyboard scan configuration options

# Copyright (c) 2019 Intel Corporation
# SPDX-License-Identifier: Apache-2.0

# menuconfig KSCAN
# 	bool "Keyboard scan drivers"
# 	help
# 	  Include Keyboard scan drivers in system config.

if KSCAN

rsource "Kconfig.sx1508"

endif # KSCAN
```

## drivers/sensor/Kconfig
```kconfig
# Copyright (c) 2022 Nordic Semiconductor ASA
# SPDX-License-Identifier: Apache-2.0

if SENSOR
rsource "fxls8974cf/Kconfig"
endif # SENSOR
```

## drivers/sensor/fxls8974cf/Kconfig
```kconfig
# FXLS8974CF 3-axis accelerometer driver


# SPDX-License-Identifier: Apache-2.0

menuconfig FXLS8974CF
	bool "fxls8974cf I2C accelerometer sensor driver"
	default y
	select I2C 
        select HAS_STMEMSC
	help
	  Enable driver for FXLS8974CF accelerometer sensor driver

if FXLS8974CF

choice FXLS8974CF_ACCEL_RANGE
	prompt "Acceleration measurement range"
	default FXLS8974CF_ACCEL_RANGE_RUNTIME
	help
	  Initial measurement full scale range for acceleration values.

config FXLS8974CF_ACCEL_RANGE_RUNTIME
	bool "Set at runtime"

config FXLS8974CF_ACCEL_RANGE_2G
	bool "+/-2g"

config FXLS8974CF_ACCEL_RANGE_4G
	bool "+/-4g"

config FXLS8974CF_ACCEL_RANGE_8G
	bool "+/-8g"

config FXLS8974CF_ACCEL_RANGE_16G
	bool "+/-16g"

endchoice

endif # FXLS8974CF
```

## smart_ble_remote/build/Kconfig/Kconfig.shield
```kconfig
osource "c:/projects/smart_ble_remote/boards/shields/*/Kconfig.shield"
osource "c:/projects/peripheral_hids_keyboard/boards/shields/*/Kconfig.shield"
osource "C:/projects/peripheral_hids_keyboard/boards/shields/*/Kconfig.shield"
osource "C:/ncs/v2.6.0/nrf/boards/shields/*/Kconfig.shield"
```

## smart_ble_remote/build/Kconfig/Kconfig.shield.defconfig
```kconfig
osource "c:/projects/smart_ble_remote/boards/shields/*/Kconfig.defconfig"
osource "c:/projects/peripheral_hids_keyboard/boards/shields/*/Kconfig.defconfig"
osource "C:/projects/peripheral_hids_keyboard/boards/shields/*/Kconfig.defconfig"
osource "C:/ncs/v2.6.0/nrf/boards/shields/*/Kconfig.defconfig"
```

## smart_ble_remote/drivers/kscan/Kconfig.sx1508
```kconfig
# Copyright (c) 2019 - 2021 Henrik Brix Andersen <henrik@brixandersen.dk>
# SPDX-License-Identifier: Apache-2.0

config KSCAN_SX1508
	bool "sx1508 keyscan driver"
	default n
	help
	  Enable keyscan driver for SX1508.

	  The SX1508 is a memory mapping, multifunction BUTTON
	  controller driver. The controller supports matrix key scan
	  circuit of up to 4x4 keys.


config SX1508_KEYSCAN_IRQ_THREAD_STACK_SIZE
	int "Stack size for keyscan interrupt request handler thread"
	default 400
	help
	  Size of the stack used for internal thread for keyscan
	  interrupt processing.

config SX1508_KEYSCAN_IRQ_THREAD_PRIO
	int "Priority for keyscan interrupt request handler thread"
	default 2
	help
	  Priority level for internal thread for keyscan interrupt
	  processing.
```
